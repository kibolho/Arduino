#ifndef UNIT_TEST
#include <Arduino.h>
#endif
#include <IRremoteESP8266.h>
#include <IRsend.h>

#define IR_LED 16  // ESP8266 GPIO pin to use. Recommended: 4 (D2).
#define RELAY_PIN 5 
#define BUTTON_PIN 0 


IRsend irsend(IR_LED);  // Set the GPIO to be used to sending the message.

// Example of data captured by IRrecvDumpV2.ino
//uint16_t rawData[347]={9012, 4508, 568, 552, 592, 568, 544, 552, 568, 1684, 564, 1684, 564,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 564,};
//Desligar
uint16_t S_off[347]={9048, 4504, 592, 532, 568, 552, 564, 576, 568, 1656, 568, 1684, 588,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 620,};
//Padrao sinal RAW Ligar Ar Condicionado Consul 25oC
uint16_t S_pwr25[347]={9012, 4508, 564, 556, 592, 544, 568, 552, 564, 1684, 564, 1688, 564,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 564,};
//Padrao sinal RAW Ligar Ar Condicionado Consul 18oC
uint16_t S_pwr18[347]={9012, 4508, 568, 552, 592, 568, 544, 552, 568, 1684, 564, 1684, 564,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 564,};

//TV Samsung
uint16_t TV_pwr[68]={4600,4350,700,1550,650,1550,650,1600,650,450,650,450,650,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1550,650};

#include <ESP8266WiFi.h>
#include <ESP8266WebServer.h>
#include <WiFiUdp.h>
#include <functional>
#include "switch.h"
#include "UpnpBroadcastResponder.h"
#include "CallbackFunction.h"

// prototypes
boolean connectWifi();

//on/off callbacks 
bool officeAcOn();
bool officeAcOff();

bool officeTvOn();
bool officeTvOff();

bool officeRelayOn();
bool officeRelayOff();

// Change this before you flash
const char* ssid = "Varoes";
const char* password = "luanabilio";

boolean wifiConnected = false;

UpnpBroadcastResponder upnpBroadcastResponder;

Switch *ac = NULL;
Switch *tv = NULL;
Switch *relay = NULL;

bool isOfficeAcOn = false;
bool isOfficeTvOn = false;
bool isOfficeRelayOn = false;

void setup()
{ 
  Serial.begin(9600);
  
  pinMode(RELAY_PIN, OUTPUT);
  irsend.begin();
  // Initialise wifi connection
  wifiConnected = connectWifi();
  
  if(wifiConnected){
    upnpBroadcastResponder.beginUdpMulticast();
    
    // Define your switches here. Max 10
    // Format: Alexa invocation name, local port no, on callback, off callback
    ac = new Switch("ac", 80, officeAcOn, officeAcOff);
    tv = new Switch("television", 81, officeTvOn, officeTvOff);
    relay = new Switch("load", 82, officeRelayOn, officeRelayOff);
    
    Serial.println("Adding switches upnp broadcast responder");
    upnpBroadcastResponder.addDevice(*ac);
    upnpBroadcastResponder.addDevice(*tv);
    upnpBroadcastResponder.addDevice(*relay);
  }
  pinMode(BUTTON_PIN, INPUT_PULLUP);
  attachInterrupt(digitalPinToInterrupt(BUTTON_PIN), handleInterrupt, FALLING);
}
 
void loop()
{
	 if(wifiConnected){
      upnpBroadcastResponder.serverLoop();
     
      ac->serverLoop();
      tv->serverLoop();
      relay->serverLoop();
	 }
}

bool officeAcOn() {
    Serial.println("AC 1 turn on ...");
    irsend.sendRaw(S_pwr18, 347, 38);
    isOfficeAcOn = true;    
    return isOfficeAcOn;
}

bool officeAcOff() {
    Serial.println("AC 1 turn off ...");
    irsend.sendRaw(S_off, 347, 38);
    isOfficeAcOn = false;
    return isOfficeAcOn;
}

bool officeTvOn() {
    Serial.println("TV 1 turn on ...");
    irsend.sendRaw(TV_pwr, 68, 38);
    isOfficeTvOn = true;    
    return isOfficeTvOn;
}

bool officeTvOff() {
    Serial.println("TV 1 turn off ...");
    irsend.sendRaw(TV_pwr, 68, 38);
    isOfficeTvOn = false;
    return isOfficeAcOn;
}
unsigned long timecount = millis();
void handleInterrupt(){
  if (timecount+500<millis()){
    if (isOfficeRelayOn){
      digitalWrite(RELAY_PIN, LOW);
      isOfficeRelayOn = false;
    }else{
      digitalWrite(RELAY_PIN, HIGH);
      isOfficeRelayOn = true;
    }
    timecount = millis();
  }
}
bool officeRelayOn() {
    Serial.println("Relay 1 turn on ...");
    digitalWrite(RELAY_PIN, HIGH);
    isOfficeRelayOn = true;    
    return isOfficeRelayOn;
}

bool officeRelayOff() {
    Serial.println("Relay 1 turn off ...");
    digitalWrite(RELAY_PIN, LOW);
    isOfficeRelayOn = false;
    return isOfficeRelayOn;
}

// connect to wifi – returns true if successful or false if not
boolean connectWifi(){
  boolean state = true;
  int i = 0;
  
  WiFi.mode(WIFI_STA);
  WiFi.begin(ssid, password);
  Serial.println("");
  Serial.println("Connecting to WiFi");

  // Wait for connection
  Serial.print("Connecting ...");
  while (WiFi.status() != WL_CONNECTED) {
    delay(500);
    Serial.print(".");
    if (i > 10){
      state = false;
      break;
    }
    i++;
  }
  
  if (state){
    Serial.println("");
    Serial.print("Connected to ");
    Serial.println(ssid);
    Serial.print("IP address: ");
    Serial.println(WiFi.localIP());
  }
  else {
    Serial.println("");
    Serial.println("Connection failed.");
  }
  
  return state;
}
